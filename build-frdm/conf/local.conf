## build-frdm/conf/local.conf
```bitbake
# ------------------------------------------------------------
# Machine / distro
# ------------------------------------------------------------
MACHINE ??= "imx8mpfrdm"
DISTRO ?= "fsl-imx-xwayland"

# ------------------------------------------------------------
# Build behavior
# ------------------------------------------------------------
CONF_VERSION = "2"
PATCHRESOLVE = "noop"
USER_CLASSES ?= "buildstats"
EXTRA_IMAGE_FEATURES = "debug-tweaks package-management"

# ------------------------------------------------------------
# Disk space monitoring (safe single-line format)
# ------------------------------------------------------------
BB_DISKMON_DIRS ??= "STOPTASKS,${TMPDIR},1G,100K STOPTASKS,${DL_DIR},1G,100K STOPTASKS,${SSTATE_DIR},1G,100K STOPTASKS,/tmp,100M,100K HALT,${TMPDIR},100M,1K HALT,${DL_DIR},100M,1K HALT,${SSTATE_DIR},100M,1K HALT,/tmp,10M,1K"

# ------------------------------------------------------------
# Downloads
# ------------------------------------------------------------
DL_DIR ?= "${BSPDIR}/downloads/"

# ------------------------------------------------------------
# NXP EULA + restricted codecs
# ------------------------------------------------------------
ACCEPT_FSL_EULA = "1"
LICENSE_FLAGS_ACCEPTED:append = " commercial"

# ------------------------------------------------------------
# Packaging
# ------------------------------------------------------------
PACKAGE_CLASSES = "package_deb"

# ------------------------------------------------------------
# Kernel / Device Tree
# IMPORTANT: this is exactly what the OS08A20 docs expect
# ------------------------------------------------------------
KERNEL_DEVICETREE = "imx8mp-frdm.dtb imx8mp-frdm-os08a20.dtb"

# ------------------------------------------------------------
# Kernel config fragments are handled by meta-openhd linux-imx bbappend.
# ------------------------------------------------------------

# Optional: autoload the sensor module (usually DT probing handles it, but harmless)
KERNEL_MODULE_AUTOLOAD:append = " os08a20"

# ------------------------------------------------------------
# Host tools (wrapped via Yocto hosttools)
# ------------------------------------------------------------
HOSTTOOLS += "dotnet node npm"

# ------------------------------------------------------------
# Image features
# ------------------------------------------------------------
IMAGE_FEATURES += "ssh-server-openssh"

# ------------------------------------------------------------
# Core image content
# ------------------------------------------------------------
IMAGE_INSTALL:append = " \
    openhd \
    nano \
    iproute2 \
    ethtool \
    v4l-utils \
    media-ctl \
    dtc \
    usb-modeswitch \
    usb-modeswitch-data \
    icu \
"

# ------------------------------------------------------------
# GStreamer (debug + bringup + encoding tests)
# ------------------------------------------------------------
IMAGE_INSTALL:append = " \
    gstreamer1.0 \
    gstreamer1.0-plugins-base \
    gstreamer1.0-plugins-good \
    gstreamer1.0-plugins-bad \
    gstreamer1.0-plugins-ugly \
    gstreamer1.0-libav \
    gstreamer1.0-plugins-imx \
"

# Use Raphael Scholle's fork for gstreamer-imx
SRC_URI:pn-gstreamer1.0-plugins-imx = "git://github.com/raphaelscholle/gst-imx.git;branch=${SRCBRANCH};protocol=https"
SRCREV:pn-gstreamer1.0-plugins-imx = "eb99b7b49ef6225eeb5c24fdc5437c603ecc7fd1"

# Allow legacy gstreamer-imx plugins to build on mx8mp machines
COMPATIBLE_MACHINE:pn-gstreamer1.0-plugins-imx:append = "|mx8mp"

# Unmask the legacy gstreamer-imx recipe directory
BBMASK:remove = "meta-freescale/recipes-multimedia/gstreamer"

# Make sure the other VPU plugin stack is NOT installed (avoid vpuenc_h264 from libgstvpu.so)
IMAGE_INSTALL:remove = " imx-gst1.0-plugin "

# ------------------------------------------------------------
# i.MX Multimedia / ISP / Display
# Provides:
#   /opt/imx8-isp/bin/start_isp.sh
#   imx8-isp.service
#   tuning XMLs
# ------------------------------------------------------------
IMAGE_INSTALL:append = " \
    isp-imx \
    libdrm \
    bash \
    coreutils \
    networkmanager \
    networkmanager-nmcli \
    wireless-tools \
    iw \
    strace \
    wpa-supplicant \
    ethtool \
    kernel-module-isp-vvcam \
    kernel-modules \
    linux-firmware \
    rtl8812au \
    rtl88x2bu \
    rtl88x2cu \
    rtl88x2eu \
"

# Keep this build on Qt 5 only. Mask standalone demo recipes that inherit
# qt6-qmake directly so the workspace still parses after removing meta-qt6.
BBMASK:append = "|meta-nxp-demo-experience/recipes-examples/imx-voice-player/imx-voice-player.bb|meta-nxp-demo-experience/recipes-gopoint/imx-gopoint/imx-gopoint_git.bb|meta-nxp-demo-experience/recipes-gopoint/imx-gopoint/nxp-demo-experience_git.bb|meta-nxp-demo-experience/recipes-gopoint/imx-image-full/imx-image-full.bbappend"
```

## sources/meta-openhd/conf/layer.conf
```bitbake
# We have a conf and classes directory, add to BBPATH
BBPATH .= ":${LAYERDIR}"

# We have recipes-* directories, add to BBFILES
BBFILES += "${LAYERDIR}/recipes-*/*/*.bb \
            ${LAYERDIR}/recipes-*/*/*.bbappend"

BBFILE_COLLECTIONS += "meta-openhd"
BBFILE_PATTERN_meta-openhd = "^${LAYERDIR}/"
BBFILE_PRIORITY_meta-openhd = "6"

LAYERDEPENDS_meta-openhd = "core"
LAYERSERIES_COMPAT_meta-openhd = "kirkstone scarthgap"

# Prevent linux-imx customizations from affecting kirkstone-based BSPs
BBMASK:append:kirkstone = "|linux-imx_%.bbappend"

# Add build timestamp file into the FAT32 boot partition for i.MX8MP FRDM images.
WKS_FILE_DEPENDS:append:imx8mp-lpddr4-frdm = " openhd-buildinfo"
IMAGE_BOOT_FILES:append:imx8mp-lpddr4-frdm = " config.txt"
```
